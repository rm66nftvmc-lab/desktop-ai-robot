## voice-device/diagnostics/wifi-sdk/sdkconfig.defaults
```kconfig
CONFIG_ESP32S3_DEFAULT_CPU_FREQ_80=y
CONFIG_ESPTOOLPY_FLASHSIZE_16MB=y
CONFIG_ESP_PHY_ENABLE_USB=y
CONFIG_ESP_PHY_MAX_WIFI_TX_POWER=10
CONFIG_ESP_PHY_REDUCE_TX_POWER=y
CONFIG_ESP_PHY_CALIBRATION_AND_DATA_STORAGE=y
CONFIG_ESP32S3_BROWNOUT_DET=y
CONFIG_ESP32S3_BROWNOUT_DET_LVL_SEL_7=y
# CONFIG_ESP32S3_SPIRAM_SUPPORT is not set
```
